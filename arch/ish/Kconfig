## arch/ish/Kconfig
```kconfig
config ISH
	def_bool y
	select GENERIC_ATOMIC64
	select GENERIC_IRQ_SHOW
	select THREAD_INFO_IN_TASK
	select HAVE_FUTEX_CMPXCHG
	select VMALLOC_BROKEN
	select HAVE_COPY_THREAD_TLS
	select SYSCTL_EXCEPTION_TRACE
	select GENERIC_SCHED_CLOCK
	select GENERIC_CPU_DEVICES
	select GENERIC_CLOCKEVENTS
	select GENERIC_SMP_IDLE_THREAD
	select ARCH_USE_QUEUED_RWLOCKS
	select ARCH_USE_QUEUED_SPINLOCKS
	select SET_FS

choice
	prompt "Link type"
config ISH_LINK_EXECUTABLE
	bool "Link the kernel as an executable and include a simple main() function"
config ISH_LINK_OBJECT
	bool "Link the kernel into a single object file"
endchoice

choice
	prompt "Emulator"
	default ISH_EMULATOR_NONE
config ISH_EMULATOR_NONE
	bool "Don't include any emulator (must be provided by a module)"
config ISH_EMULATOR_ISHEMU
	bool "Use iSH emulator"
config ISH_EMULATOR_UNICORN
	bool "Use unicorn emulator"
endchoice

config ARCH_KALLSYMS
	depends on KALLSYMS
	bool "Use dladdr for kallsyms"
	default y

config ARCH_RANDOM
	def_bool y
config RANDOM_TRUST_CPU
	def_bool y

config LOCKDEP_SUPPORT
	def_bool y
config STACKTRACE_SUPPORT
	def_bool y
config TRACE_IRQFLAGS_SUPPORT
	def_bool y

# ABI vore
config 64BIT
	bool
	default y
config COMPAT
	def_bool y
config COMPAT_FOR_U64_ALIGNMENT
	def_bool y
config IA32_EMULATION
	def_bool y
config SYSVIPC_COMPAT
	def_bool y
	depends on SYSVIPC

config MMU
	bool
	default y

config SMP
	bool "Symmetric multi-processing support"
	default y
config NR_CPUS
	int "Maximum number of CPUs"
	range 2 32
	depends on SMP
	default 8

config HZ
	int "HZ"
	default 100

config PGTABLE_LEVELS
	int
	default 3

config NO_DMA
	def_bool y
config NO_IOMEM
	def_bool y
config NO_VMALLOC
	def_bool y
config GENERIC_HWEIGHT
	def_bool y
config GENERIC_CSUM
	def_bool y

config HOSTFS
	bool "Host filesystem"

config HOST_INET
	bool "Host-based AF_INET"
	default y
	depends on NET && !INET

config GOLP
	bool "Golp interface"
	default y
	depends on INET

config GOLP_AUTOCONFIG
	bool "Autoconfigure golp on startup"
	default y
	depends on !IP_PNP

config STDIO_CONSOLE
	bool "Console on stdin/stdout"
	default y
```
